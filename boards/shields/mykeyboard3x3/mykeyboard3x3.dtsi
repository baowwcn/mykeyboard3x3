#include <dt-bindings/zmk/matrix_transform.h>

//#include "kyria-layouts.dtsi"

/ {
    chosen {
        zephyr,display = &oled;
        zmk,kscan = &kscan0;
        zmk,physical-layout = &splitkb_kyria_6col_layout;
    };

    encoder: encoder {
        compatible = "alps,ec11";
        steps = <80>;
        status = "disabled";
    };

};

&encoder {
    a-gpios = <&pro_micro 21 (GPIO_ACTIVE_HIGH | GPIO_PULL_UP)>;
    b-gpios = <&pro_micro 20 (GPIO_ACTIVE_HIGH | GPIO_PULL_UP)>;
};

