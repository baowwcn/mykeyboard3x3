## boards/shields/mykeyboard3x3/Kconfig.defconfig
```kconfig
if SHIELD_mykeyboard3x3

config ZMK_KEYBOARD_NAME
    default "mykeyboard3x3"

endif
```

## boards/shields/mykeyboard3x3/Kconfig.shield
```kconfig
# No whitespace after the comma or in your keyboard name!
config SHIELD_mykeyboard3x3
    def_bool $(shields_list_contains,mykeyboard3x3)
```
